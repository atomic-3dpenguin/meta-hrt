## conf/layer.conf
```bitbake
# hrt Layer Configuration
BBPATH .= ":${LAYERDIR}"
BBFILES ?= ""

BBLAYERS_LAYERINDEX_NAME = "meta-hrt"

LAYERVERSION_meta-hrt = "1"
LAYERDEPENDS_meta-hrt = "core meta-ti meta-openembedded meta-beagleboard"
```
